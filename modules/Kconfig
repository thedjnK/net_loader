## modules/Kconfig
```kconfig
#
# Copyright (C) 2023 Jamie M.
#
# SPDX-License-Identifier: Apache-2.0
#

if MCUBOOT

rsource "mcuboot/Kconfig"

endif

rsource "watchdog/Kconfig"
```

## modules/mcuboot/Kconfig
```kconfig
#
# Copyright (C) 2023 Jamie M.
#
# SPDX-License-Identifier: Apache-2.0
#

config MCUBOOT_WATCHDOG_SETUP
	bool "Setup watchdog at boot"
	default y
	select WATCHDOG
	select MCUBOOT_ACTION_HOOKS

config MCUBOOT_WATCHDOG_TIMEOUT
	int "Watchdog timeout (seconds)"
	range 10 7200
	depends on MCUBOOT_WATCHDOG_SETUP
```

## modules/watchdog/Kconfig
```kconfig
#
# Copyright (C) 2023 Jamie M.
#
# SPDX-License-Identifier: Apache-2.0
#

config WATCHDOG_FEED_TIME
	int "Watchdog feed time (seconds)"
	range 5 3600
```

## net_loader/sysbuild/mcuboot/boards/bl5340_dvk_cpuapp.conf
```kconfig
#CONFIG_BOOT_SIGNATURE_TYPE_NONE=y
CONFIG_MCUBOOT_CLEANUP_ARM_CORE=y
#CONFIG_BOOT_DIRECT_XIP=y
#CONFIG_BOOT_DIRECT_XIP_REVERT=y
CONFIG_GPIO=n
CONFIG_GPIO_PCA953X=n
CONFIG_I2C=n
CONFIG_SERIAL=n
CONFIG_CONSOLE=n
CONFIG_LOG=n
CONFIG_DEBUG=n
CONFIG_FP16=n
CONFIG_BOOT_MAX_IMG_SECTORS=256
CONFIG_SPEED_OPTIMIZATIONS=y
CONFIG_CBPRINTF_REDUCED_INTEGRAL=y
CONFIG_MINIMAL_LIBC_REALLOCARRAY=n
CONFIG_MINIMAL_LIBC_CALLOC=n
CONFIG_MINIMAL_LIBC_TIME=n
CONFIG_MINIMAL_LIBC_MALLOC=n
CONFIG_NORDIC_QSPI_NOR=n

CONFIG_BOOT_FIRMWARE_LOADER=y
CONFIG_WATCHDOG=y
#CONFIG_BOOT_FIRMWARE_LOADER_NO_APPLICATION=y
CONFIG_BOOT_FIRMWARE_LOADER_BOOT_MODE=y

CONFIG_RETAINED_MEM=y
CONFIG_RETENTION=y
CONFIG_RETENTION_BOOT_MODE=y
```

## sysbuild/Kconfig
```kconfig
#
# Copyright (C) 2023 Jamie M.
#
# SPDX-License-Identifier: Apache-2.0
#

config WATCHDOG_TIMEOUT_TIME
        int "Watchdog timeout (seconds)"
        range 10 7200
        default 240
```

## west.yml
```yaml
manifest:
  remotes:
    - name: zephyr
      url-base: https://github.com/zephyrproject-rtos
    - name: mcutools
      url-base: https://github.com/mcu-tools
    - name: thedjnK
      url-base: https://github.com/thedjnK

  projects:
    - name: zephyr
      remote: zephyr
      revision: main
      import:
        name-allowlist:
          - cmsis
          - hal_nordic
          - libmetal
          - littlefs
          - mbedtls
          - mcuboot
          - openamp
          - tinycrypt
          - zcbor
    - name: boards
      remote: thedjnK
      revision: main

  self:
    path: net_loader
```
